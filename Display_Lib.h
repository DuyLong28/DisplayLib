#ifndef Bitmap_H
#define Bitmap_H

#include <Wire.h>
#include <time.h>

// Phát hiện nền tảng (ESP32 hoặc ESP8266)
#ifdef ESP32
  #include <WiFi.h>
#else
  #include <ESP8266WiFi.h>
#endif

// Phát hiện loại màn hình (SH1106 hoặc SSD1306)
#include <Adafruit_GFX.h>
#ifdef USE_SSD1306
  #include <Adafruit_SSD1306.h>
  Adafruit_SSD1306 oled(128, 64, &Wire, -1);
  #define WHITE SSD1306_WHITE
#else
  #include <Adafruit_SH110X.h>
  Adafruit_SH1106G oled = Adafruit_SH1106G(128, 64, &Wire, -1);
  #define WHITE SH110X_WHITE
#endif
#define SCREEN_ADDRESS 0x3C
// ESP32: SCL-22; SDA-21
// ESP8266: SCL-5(D1); SDA-4(D2)

const uint8_t EnableWifi[] PROGMEM = {
  0x00, 0x00, 0x00, 0x00, 0x00, 0x00, 0x00, 0x00, 0x00, 0x00, 0x00, 0x00, 0x00, 0x00, 0x00, 0x00,
  0x7F, 0xC0, 0x00, 0x06, 0x00, 0x00, 0x00, 0x00, 0x00, 0x00, 0x00, 0x00, 0x00, 0x0F, 0xFF, 0xFE,
  0x44, 0x40, 0x00, 0x25, 0x00, 0x00, 0x00, 0x00, 0x00, 0x00, 0x00, 0x07, 0xF8, 0x08, 0x00, 0x02,
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  0xFF, 0xFF, 0xFF, 0xFF, 0xFF, 0xFF, 0xFF, 0xFF, 0xFF, 0xFF, 0xFF, 0xFF, 0xFF, 0xFF, 0xFF, 0xFF
};

const uint8_t DisableWifi[] PROGMEM = {
  0x00, 0x00, 0x00, 0x00, 0x00, 0x00, 0x00, 0x00, 0x00, 0x00, 0x00, 0x0C, 0x00, 0x00, 0x00, 0x00,
  0x7F, 0xC0, 0x00, 0x06, 0x00, 0x00, 0x00, 0x00, 0x00, 0x00, 0x00, 0x06, 0x00, 0x0F, 0xFF, 0xFE,
  0x44, 0x40, 0x00, 0x25, 0x00, 0x00, 0x00, 0x00, 0x00, 0x00, 0x00, 0x07, 0xF8, 0x08, 0x00, 0x02,
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  0xFF, 0xFF, 0xFF, 0xFF, 0xFF, 0xFF, 0xFF, 0xFF, 0xFF, 0xFF, 0xFF, 0xFF, 0xFF, 0xFF, 0xFF, 0xFF
};

// Bitmap Robot Face: Normal, Funny, NoFeel, NoEye, Sad, Angry
const uint8_t Normal[] PROGMEM = {
  0x00, 0x00, 0x00, 0x00, 0x00, 0x00, 0x00, 0x00, 0x00, 0x00, 0x00, 0x00, 0x00, 0x00, 0x00, 0x00,
  0x00, 0x00, 0x00, 0x00, 0x00, 0x00, 0x00, 0x00, 0x00, 0x00, 0x00, 0x00, 0x00, 0x00, 0x00, 0x00,
  0x00, 0x00, 0x00, 0x00, 0x00, 0x00, 0x00, 0x00, 0x00, 0x00, 0x00, 0x00, 0x00, 0x00, 0x00, 0x00,
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  0x00, 0x00, 0x00, 0x00, 0x00, 0x00, 0x00, 0x00, 0x00, 0x00, 0x00, 0x00, 0x00, 0x00, 0x00, 0x00
};

const uint8_t Funny[] PROGMEM = {
  0x00, 0x00, 0x00, 0x00, 0x00, 0x00, 0x00, 0x00, 0x00, 0x00, 0x00, 0x00, 0x00, 0x00, 0x00, 0x00,
  0x00, 0x00, 0x00, 0x00, 0x00, 0x00, 0x00, 0x00, 0x00, 0x00, 0x00, 0x00, 0x00, 0x00, 0x00, 0x00,
  0x00, 0x00, 0x00, 0x00, 0x00, 0x00, 0x00, 0x00, 0x00, 0x00, 0x00, 0x00, 0x00, 0x00, 0x00, 0x00,
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  0x00, 0x00, 0x00, 0x00, 0x00, 0x00, 0x00, 0x00, 0x00, 0x00, 0x00, 0x00, 0x00, 0x00, 0x00, 0x00
};

const uint8_t NoFeel[] PROGMEM = {
  0x00, 0x00, 0x00, 0x00, 0x00, 0x00, 0x00, 0x00, 0x00, 0x00, 0x00, 0x00, 0x00, 0x00, 0x00, 0x00,
  0x00, 0x00, 0x00, 0x00, 0x00, 0x00, 0x00, 0x00, 0x00, 0x00, 0x00, 0x00, 0x00, 0x00, 0x00, 0x00,
  0x00, 0x00, 0x00, 0x00, 0x00, 0x00, 0x00, 0x00, 0x00, 0x00, 0x00, 0x00, 0x00, 0x00, 0x00, 0x00,
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  0x00, 0x00, 0x00, 0x00, 0x00, 0x00, 0x00, 0x00, 0x00, 0x00, 0x00, 0x00, 0x00, 0x00, 0x00, 0x00
};

const uint8_t NoEye[] PROGMEM = {
  0x00, 0x00, 0x00, 0x00, 0x00, 0x00, 0x00, 0x00, 0x00, 0x00, 0x00, 0x00, 0x00, 0x00, 0x00, 0x00,
  0x00, 0x00, 0x00, 0x00, 0x00, 0x00, 0x00, 0x00, 0x00, 0x00, 0x00, 0x00, 0x00, 0x00, 0x00, 0x00,
  0x00, 0x00, 0x00, 0x00, 0x00, 0x00, 0x00, 0x00, 0x00, 0x00, 0x00, 0x00, 0x00, 0x00, 0x00, 0x00,
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  0x00, 0x00, 0x00, 0x00, 0x00, 0x00, 0x00, 0x00, 0x00, 0x00, 0x00, 0x00, 0x00, 0x00, 0x00, 0x00
};

const uint8_t Sad[] PROGMEM = {
  0x00, 0x00, 0x00, 0x00, 0x00, 0x00, 0x00, 0x00, 0x00, 0x00, 0x00, 0x00, 0x00, 0x00, 0x00, 0x00,
  0x00, 0x00, 0x00, 0x00, 0x00, 0x00, 0x00, 0x00, 0x00, 0x00, 0x00, 0x00, 0x00, 0x00, 0x00, 0x00,
  0x00, 0x00, 0x00, 0x00, 0x00, 0x00, 0x00, 0x00, 0x00, 0x00, 0x00, 0x00, 0x00, 0x00, 0x00, 0x00,
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  0x00, 0x00, 0x00, 0x00, 0x00, 0x00, 0x00, 0x00, 0x00, 0x00, 0x00, 0x00, 0x00, 0x00, 0x00, 0x00
};

const uint8_t Angry[] PROGMEM = {
  0x00, 0x00, 0x00, 0x00, 0x00, 0x00, 0x00, 0x00, 0x00, 0x00, 0x00, 0x00, 0x00, 0x00, 0x00, 0x00,
  0x00, 0x00, 0x00, 0x00, 0x00, 0x00, 0x00, 0x00, 0x00, 0x00, 0x00, 0x00, 0x00, 0x00, 0x00, 0x00,
  0x00, 0x00, 0x00, 0x00, 0x00, 0x00, 0x00, 0x00, 0x00, 0x00, 0x00, 0x00, 0x00, 0x00, 0x00, 0x00,
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  0x00, 0x00, 0x00, 0x00, 0x00, 0x00, 0x00, 0x00, 0x00, 0x00, 0x00, 0x00, 0x00, 0x00, 0x00, 0x00
};

void checkOled() {
  // Kiểm tra kết nối oled
  if (!oled.begin()) {
    Serial.println(F("Display allocation failed"));
    for (;;); // Dừng chương trình nếu không khởi tạo được màn hình oled
  }
}

// Hàm vẽ bitmap
void drawBitmap(const uint8_t* bitmap, int16_t x, int16_t y, int16_t width, int16_t height) {
  oled.clearDisplay();
  oled.drawBitmap(x, y, bitmap, width, height, WHITE);  // Vẽ bitmap tại tọa độ (x, y) với kích thước width x height
  oled.display();
}

void displayConnectWifi(const char* ssid) {
  static int dotCount = 0;
  oled.clearDisplay();
  oled.setTextColor(WHITE);
  drawBitmap(DisableWifi, 0, 0, 128, 12);
  oled.setCursor(0,14);
  oled.print("SSID: ");
  oled.println(ssid);
  oled.print("\nConnecting Wifi");
  for (int i = 0; i <= dotCount; i++) {
    oled.print(".");
  }
  oled.display();
  dotCount = (dotCount + 1) % 3;
};

void displayConnectedWifi() {
  oled.clearDisplay();
  oled.setTextColor(WHITE);
  drawBitmap(EnableWifi, 0, 0, 128, 12);
  oled.setCursor(0,14);
  oled.println("Wifi Connected");
  oled.print("\nIP: ");
  oled.print(WiFi.localIP());
  oled.display();
  delay(3000);
  display.clearDisplay();
};

void connectWifi(const char* ssid, const char* pass) {
  // Kết nối wifi
  Serial.print("Connecting to ");
  Serial.println(ssid);
  WiFi.begin(ssid, pass);
  while (WiFi.status() != WL_CONNECTED)
  {
    delay(500);
    Serial.print(".");
    displayConnectWifi(ssid); // Hiển thị thông tin trên oled
  }
  Serial.println();
  Serial.println("WiFi connected");
  Serial.print("IP address: ");
  Serial.println(WiFi.localIP());
  displayConnectedWifi();
}

void checkWifi(const char* ssid, const char* pass) {
  if (WiFi.status() != WL_CONNECTED) {
    Serial.println("WiFi lost connection, reconnecting...");
    connectWifi(ssid, pass);
  }
}

void displayConnectingNTP() {
  static int dotCount = 0;
  oled.clearDisplay();
  oled.setTextColor(WHITE);
  drawBitmap(EnableWifi, 0, 0, 128, 12);
  oled.setCursor(0,14);
  oled.println("Connecting to NTP");
  Serial.println("Connecting to NTP");
  for (int i = 0; i <= dotCount; i++) {
    oled.print(".");
  }
  oled.display();
  dotCount = (dotCount + 1) % 3;
}

int timezone = 7 * 3600;
int dst = 0;

bool connectNTP() {
  const unsigned long timeout = 10000; // 10 giây timeout
  unsigned long startTime = millis(); // Lấy thời điểm bắt đầu

  // Cấu hình thời gian NTP
  configTime(timezone, dst, "pool.ntp.org", "time.nist.gov");
  
  while (!time(nullptr)) {
    if (millis() - startTime >= timeout) {
      Serial.println("NTP connection timeout");
      return false; // Timeout sau 10 giây
    }
    displayConnectingNTP(); // Hiển thị quá trình kết nối NTP
    Serial.print(".");
    delay(1000); // Chờ 1 giây giữa các lần thử kết nối
  }
  return true; // Kết nối thành công
}

void displayConnectedNTP() {
  oled.setTextColor(WHITE);
  drawBitmap(EnableWifi, 0, 0, 128, 12);
  oled.setCursor(0,14);
  oled.println("Time response: OK");
  Serial.println("Time response: OK");
  oled.display();
  delay(5000);
  oled.clearDisplay();
}

// Khai báo biến thời gian
time_t now;
struct tm* p_tm;

void updateTime() {
  // Lấy thời gian hiện tại và cập nhật biến toàn cục
  now = time(nullptr);
  p_tm = localtime(&now);
}

void displayTimeSerial() {
  updateTime();
  
  // Hiển thị qua Serial
  Serial.print(p_tm->tm_mday);
  Serial.print("/");
  Serial.print(p_tm->tm_mon + 1);
  Serial.print("/");
  Serial.print(p_tm->tm_year + 1900);
  
  Serial.print(" ");
  
  Serial.print(p_tm->tm_hour);
  Serial.print(":");
  Serial.print(p_tm->tm_min);
  Serial.print(":");
  Serial.println(p_tm->tm_sec);
}

void displayTime() {
  updateTime();
  
  // Hiển thị giờ phút trên màn hình
  oled.clearDisplay();
  oled.setTextSize(1);
  oled.setTextColor(WHITE);
  drawBitmap(EnableWifi, 0, 0, 128, 12);
  oled.setCursor(50, 2);
  
  if (p_tm->tm_hour < 10)
    oled.print("0"); 
    oled.print(p_tm->tm_hour);
    oled.print(":");
  
  if (p_tm->tm_min < 10)
    oled.print("0"); 
    oled.print(p_tm->tm_min);
  
  oled.display();
  
  // Cập nhật mỗi 15 giây
  delay(15000);
}

#endif
